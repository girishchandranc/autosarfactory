AUTOSAR XML (schema 00049)
package /Can/signals
  i signal sig1: length=4, i-signal-type=PRIMITIVE, system-signal=syssig1
package /Can/systemsignals
  system signal syssig1
package /Can/ecus
  ecu instance ecu1: sleep-mode-supported=false, wake-up-over-bus-supported=false
package /Can/system
  system CanSystem
    system mapping Mappings: sender-receiver-to-signal-mapping{system-signal=syssig1, data-element=outPort.de1}
      sw-mappings:
        swc to ecu mapping SwcMapping: ecu-instance=ecu1, component=rootSwcom.asw1_proto.asw2_proto
    root-software-compositions:
      root sw composition prototype rootSwcom: software-composition=Comp
