AUTOSAR XML (schema 00051)
package /Can/signals
  i signal sig1: i-signal-type=PRIMITIVE, length=4, system-signal=syssig1
package /Can/systemsignals
  system signal syssig1: dynamic-length=true
package /Can/ecus
  ecu instance ecu1: sleep-mode-supported=false, wake-up-over-bus-supported=true
package /Can/system
  system CanSystem
    system mapping Mappings: sender-receiver-to-signal-mapping{data-element=outPort.de1, system-signal=syssig1}
      sw-mappings:
        swc to ecu mapping SwcMapping: component=rootSwcom.asw1_proto.asw2_proto.asw1_proto, ecu-instance=ecu1
    root-software-compositions:
      root sw composition prototype rootSwcom: software-composition=Comp
