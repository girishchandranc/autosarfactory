AUTOSAR XML (schema 00052)
package /types
  std cpp implementation data type Array: category=ARRAY, array-size=6, type-emitter=TYPE_EMITTER_ARA
    namespaces:
      symbol props namespace_ns: symbol=ns
