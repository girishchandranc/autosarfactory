AUTOSAR XML (schema 00049)
standard types defined: uint8
