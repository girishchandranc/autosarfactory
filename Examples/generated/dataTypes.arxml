AUTOSAR XML (schema 00051)
standard types defined: uint8
package /DataTypes/compuMethods
  compu method cm1: 0=ECU_STATE_STOP, 1=ECU_STATE_START, 2=ECU_STATE_RUN
package /DataTypes/dataConstrs
  range dc1: raw -128..127
