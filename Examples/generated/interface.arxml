AUTOSAR XML (schema 00053)
package /Interfaces
  sender receiver interface srif1
    data de1: type=uint8, init-value=1
