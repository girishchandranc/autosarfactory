AUTOSAR XML (schema 00053)
package /Swcs
  application sw component type asw1
