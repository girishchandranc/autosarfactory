AUTOSAR XML (schema 00053)
package /Swcs
  application sw component type asw1
    require port portInFile2
    provide port newPortInFile2
