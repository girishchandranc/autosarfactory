AUTOSAR XML (schema 00053)
package /AUTOSAR/EcucDefs
  module definition Os
    container OsTask
      integer OsTaskPriority
