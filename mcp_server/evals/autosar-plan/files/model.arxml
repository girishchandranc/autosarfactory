AUTOSAR XML (schema 00053)
package /Interfaces
  sender receiver interface SrIf_Speed
    data Speed
package /Swcs
  application sw component type SpeedReceiver
