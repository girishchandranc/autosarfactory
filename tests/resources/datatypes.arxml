AUTOSAR XML (schema 00049)
standard types defined: uint8
package /DataTypes/compuMethods
  compu method cm1: 0=ECU_STATE_STOP, 1=ECU_STATE_START, 2=ECU_STATE_RUN
  compu method cm2: phys=(100+200*raw+300*raw^2)/(1)
