AUTOSAR XML (schema 00051)
package /RootPackage
  diagnostic extended data record Record1
    diagnostic-parameter bit-offset=0:
      diagnostic data element element1
  diagnostic service sw mapping map1: diagnostic-data-element=element1
