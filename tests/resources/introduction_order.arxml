AUTOSAR XML (schema 4.0)
package /Defs
  module definition Mod
    container Cont  # Container lead-in item After the list
      integer ParamMixed [0..1]  # P1 P2 a b one P3 P4
      integer ParamListFirst  # x Text y Tail
      boolean ParamVerbatim  # Intro code Between x more code
      integer ParamNested  # first sub after sub second
      integer ParamEmpty
