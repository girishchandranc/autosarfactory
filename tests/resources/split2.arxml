AUTOSAR XML (schema 4-2-2)
package /System
  composition sw component type Composition_A
    component CPT_Component2: type=Component2
package /ComponentPkg
  application sw component type Component2
